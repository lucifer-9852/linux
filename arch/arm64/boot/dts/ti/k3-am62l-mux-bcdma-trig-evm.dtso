// SPDX-License-Identifier: GPL-2.0
/*
 * Copyright (C) 2026 Texas Instruments Incorporated - https://www.ti.com/
 */

/dts-v1/;
/plugin/;
#include <dt-bindings/gpio/gpio.h>
#include <dt-bindings/interrupt-controller/irq.h>
#include "k3-pinctrl.h"

&pmx0 {
	bcdma_trig_pins_default: bcdma-trig-pins-default {
		pinctrl-single,pins = <
			AM62LX_IOPAD(0x00e0, PIN_INPUT, 7) /* (M21) GPMC0_DIR.GPIO0_40 */
		>;
	};
};

&main_bcdma {
	/* GPIO trigger sources for BCDMA triggers */
	trigger-gpios = <&main_gpio0 40 GPIO_ACTIVE_HIGH>;
	interrupts-extended = <&main_gpio0 40 IRQ_TYPE_EDGE_RISING>;

	pinctrl-names = "default";
	pinctrl-0 = <&bcdma_trig_pins_default>;
};

